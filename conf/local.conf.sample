## conf/local.conf.sample
```bitbake
MACHINE ??= 'imx8mmevk'
DISTRO ?= 'fsl-imx-xwayland'
PACKAGE_CLASSES ?= "package_ipk"
EXTRA_IMAGE_FEATURES ?= "debug-tweaks package-management"
USER_CLASSES ?= "buildstats image-mklibs image-prelink"
PATCHRESOLVE = "noop"
BB_DISKMON_DIRS ??= "\
    STOPTASKS,${TMPDIR},1G,100K \
    STOPTASKS,${DL_DIR},1G,100K \
    STOPTASKS,${SSTATE_DIR},1G,100K \
    STOPTASKS,/tmp,100M,100K \
    ABORT,${TMPDIR},100M,1K \
    ABORT,${DL_DIR},100M,1K \
    ABORT,${SSTATE_DIR},100M,1K \
    ABORT,/tmp,10M,1K"
PACKAGECONFIG_append_pn-qemu-native = " sdl"
PACKAGECONFIG_append_pn-nativesdk-qemu = " sdl"
CONF_VERSION = "1"

DL_DIR ?= "/mnt/build/downloads/"
ACCEPT_FSL_EULA = "1"

# Remove the old image before the new one generated to save disk space
RM_OLD_IMAGE = "1"

# Sources Configuration Section
# PREFERRED_VERSION_qt5-emcraft-demo = "git"
# CONFIG_QTDEMO_BRANCH = "8mmini"
# For release
PREFERRED_VERSION_qt5-emcraft-demo = "0.9"
```

## conf/machine/imx8m-som-2gb-ddr800.conf
```bitbake
#@TYPE: Machine
#@NAME: Emcraft i.MX8MQ SOM Starter Kit
#@SOC: i.MX8MQ
#@DESCRIPTION: Machine configuration for Emcraft i.MX8MQ SOM Starter Kit
#@MAINTAINER: Sergei Poselenov <a2f-linux-support@emcraft.com>

require imx8m-som.conf

UBOOT_CONFIG[sd] = "imx8m_lpddr4_800mhz_2gb_som_config,sdcard"
```

## conf/machine/imx8m-som.conf
```bitbake
#@TYPE: Machine
#@NAME: Emcraft i.MX8MQ SOM Starter Kit
#@SOC: i.MX8MQ
#@DESCRIPTION: Machine configuration for Emcraft i.MX8MQ SOM Starter Kit
#@MAINTAINER: Sergei Poselenov <a2f-linux-support@emcraft.com>

require conf/machine/include/arm/arch-arm64.inc
require conf/machine/include/imx-base.inc

# PREFERRED_PROVIDER_u-boot = "u-boot-emcraft"

MACHINE_FEATURES += " pci wifi bluetooth"

MACHINEOVERRIDES =. "mx8:mx8mq:"
MACHINEOVERRIDES =. "imx:"

MACHINE_SOCARCH_FILTER_append_mx8mq = "virtual/libopenvg virtual/libgles1 virtual/libgles2 virtual/egl virtual/mesa virtual/libgl virtual/libg2d"

KERNEL_DEVICETREE = "imx8m-som.dtb "
KERNEL_DEVICETREE += "imx8m-som-mipi-frd55.dtb"

IMAGE_M4LOADER = "imx-m4-demos"
IMAGE_M4 = "imx8mq_m4_TCM_hello_world.bin imx8mq_m4_TCM_rpmsg_lite_pingpong_rtos_linux_remote.bin imx8mq_m4_TCM_rpmsg_lite_str_echo_rtos.bin"

UBOOT_CONFIG ??= "sd"
UBOOT_CONFIG[sd] = "imx8m_lpddr4_som_config,sdcard"
UBOOT_CONFIG[mfgtool] = "imx8m_lpddr4_som_config"
SPL_BINARY = "spl/u-boot-spl.bin"

# Set u-boot DTB
UBOOT_DTB_NAME = "emcraft-imx8m-som.dtb"

# Set imx-mkimage boot target
IMXBOOT_TARGETS = "flash_evk"

# Set Serial console
SERIAL_CONSOLE = "115200 ttymxc0"

IMAGE_BOOTLOADER = "imx-boot"

SDCARD_GENERATION_COMMAND_mx8 = "generate_imx_sdcard"

DEFAULTTUNE_mx8 = "aarch64"

IMX_DEFAULT_KERNEL_mx8mq = "linux-imx"

BOOT_SPACE = "32768"

KERNEL_IMAGETYPE = "Image"
LOADADDR = ""
UBOOT_SUFFIX = "bin"
UBOOT_MAKE_TARGET = ""
IMX_BOOT_SEEK = "33"
```

## conf/machine/imx8mmsom.conf
```bitbake
#@TYPE: Machine
#@NAME: NXP i.MX8MM SOM Starter Kit
#@SOC: i.MX8MM
#@DESCRIPTION: Machine configuration for Emcraft i.MX8MMini SOM
#@MAINTAINER: Sergei Poselenov <a2f-linux-support@emcraft.com>

MACHINEOVERRIDES =. "mx8:mx8m:mx8mm:"

require conf/machine/include/imx-base.inc
require conf/machine/include/arm/arch-arm64.inc

MACHINE_FEATURES += " pci wifi bluetooth optee qca9377 qca6174"

MACHINE_SOCARCH_FILTER_append_mx8mm = "virtual/libopenvg virtual/libgles1 virtual/libgles2 virtual/egl virtual/mesa virtual/libgl virtual/libg2d"

KERNEL_DEVICETREE = "emcraft/emcraft-imx8mm-som.dtb emcraft/emcraft-imx8mm-som-mipi-adv7535.dtb emcraft/emcraft-imx8mm-som-mipi-frd55.dtb"

IMAGE_BOOTFILES_DEPENDS += "imx-m4-demos:do_deploy"
IMAGE_BOOTFILES += "imx8mm_m4_TCM_hello_world.bin \
                    imx8mm_m4_TCM_rpmsg_lite_pingpong_rtos_linux_remote.bin \
                    imx8mm_m4_TCM_rpmsg_lite_str_echo_rtos.bin \
                    imx8mm_m4_TCM_sai_low_power_audio.bin \
"

UBOOT_CONFIG ??= "sd"
UBOOT_CONFIG[sd] = "imx8mm_som_config,sdcard"
UBOOT_CONFIG[mfgtool] = "imx8mm_som_config"
SPL_BINARY = "spl/u-boot-spl.bin"

# Set DDR FIRMWARE
DDR_FIRMWARE_NAME = "lpddr4_pmu_train_1d_imem.bin lpddr4_pmu_train_1d_dmem.bin lpddr4_pmu_train_2d_imem.bin lpddr4_pmu_train_2d_dmem.bin"

# Set u-boot DTB
UBOOT_DTB_NAME = "emcraft-imx8mm-som.dtb"

# Set imx-mkimage boot target
IMXBOOT_TARGETS = "${@bb.utils.contains('UBOOT_CONFIG', 'fspi', 'flash_evk_flexspi', 'flash_evk', d)}"

# Set Serial console
SERIAL_CONSOLE = "115200 ttymxc1"

IMAGE_BOOTLOADER = "imx-boot"

BOOT_SPACE = "65536"

LOADADDR = ""
UBOOT_SUFFIX = "bin"
UBOOT_MAKE_TARGET = ""
IMX_BOOT_SEEK = "33"
```

## conf/machine/imx8mmsom1gb.conf
```bitbake
#@TYPE: Machine
#@NAME: NXP i.MX8MM SOM Starter Kit
#@SOC: i.MX8MM
#@DESCRIPTION: Machine configuration for Emcraft i.MX8MMini SOM
#@MAINTAINER: Sergei Poselenov <a2f-linux-support@emcraft.com>

require imx8mmsom.conf

UBOOT_CONFIG[sd] = "imx8mm_som_1gb_defconfig,sdcard"
```

## conf/machine/imx8msom.conf
```bitbake
#@TYPE: Machine
#@NAME: Emcraft i.MX8M SOM
#@SOC: i.MX8MQ
#@DESCRIPTION: Machine configuration for NXP i.MX8MQ EVK
#@MAINTAINER: Dmitry Konyshev <probables@emcraft.com>

MACHINEOVERRIDES =. "mx8:mx8m:mx8mq:"

require conf/machine/include/imx-base.inc
require conf/machine/include/arm/arch-arm64.inc

MACHINE_FEATURES += " pci wifi bluetooth optee qca6174"

KERNEL_DEVICETREE += "emcraft/emcraft-imx8m-som.dtb emcraft/emcraft-imx8m-som-mipi-frd55.dtb"

IMAGE_BOOTFILES_DEPENDS += "imx-m4-demos:do_deploy"
IMAGE_BOOTFILES += "imx8mq_m4_TCM_hello_world.bin imx8mq_m4_TCM_rpmsg_lite_pingpong_rtos_linux_remote.bin imx8mq_m4_TCM_rpmsg_lite_str_echo_rtos.bin"

UBOOT_CONFIG ??= "sd"
UBOOT_CONFIG[sd] = "imx8m_lpddr4_1gb_som_config,sdcard"
SPL_BINARY = "spl/u-boot-spl.bin"

# Set DDR FIRMWARE
DDR_FIRMWARE_NAME = "lpddr4_pmu_train_1d_imem.bin lpddr4_pmu_train_1d_dmem.bin lpddr4_pmu_train_2d_imem.bin lpddr4_pmu_train_2d_dmem.bin"

# Set u-boot DTB
UBOOT_DTB_NAME = "emcraft-imx8m-som.dtb"

# Set imx-mkimage boot target
IMXBOOT_TARGETS = "flash_evk flash_evk_no_hdmi flash_dp_evk"

# Set Serial console
SERIAL_CONSOLE = "115200 ttymxc0"

IMAGE_BOOTLOADER = "imx-boot"

BOOT_SPACE = "65536"

LOADADDR = ""
UBOOT_SUFFIX = "bin"
UBOOT_MAKE_TARGET = ""
IMX_BOOT_SEEK = "33"
```

## conf/machine/imx8msom3gb.conf
```bitbake
#@TYPE: Machine
#@NAME: NXP i.MX8M SOM Starter Kit
#@SOC: i.MX8M
#@DESCRIPTION: Machine configuration for Emcraft i.MX8M SOM
#@MAINTAINER: Sergei Poselenov <a2f-linux-support@emcraft.com>

require imx8msom.conf

UBOOT_CONFIG[sd] = "imx8m_lpddr4_3gb_som_defconfig,sdcard"
```
