/*
 * Copyright 2018 Emcraft Systems
 *
 * This program is free software; you can redistribute it and/or
 * modify it under the terms of the GNU General Public License
 * as published by the Free Software Foundation; either version 2
 * of the License, or (at your option) any later version.
 *
 * This program is distributed in the hope that it will be useful,
 * but WITHOUT ANY WARRANTY; without even the implied warranty of
 * MERCHANTABILITY or FITNESS FOR A PARTICULAR PURPOSE.  See the
 * GNU General Public License for more details.
 */

/*
 * Enable camera on CSI2 channel on the J9 IMX8M-SOM-BSB connector
 * instead of CSI1 on J8.
 */
#define CSI2_CAM_ENABLE

#include "imx8m-som.dts"
